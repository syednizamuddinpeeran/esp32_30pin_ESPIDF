## kconfig/main/Kconfig.projbuild
```kconfig
menu "Project Configuration"

    config STRING
        string "STRING"
        default "Hello world"
        help
            the string will be printed on the console.
endmenu
    
```
